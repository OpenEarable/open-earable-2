## tests/unit/audio_sync_math/testcase.yaml
```yaml
tests:
  openearable.unit.audio_sync_math:
    tags:
      - unit
      - audio
    integration_platforms:
      - native_sim/native/64
    platform_allow:
      - native_sim/native/64
```
