## CMakeLists.txt
```
# SPDX-License-Identifier: Apache-2.0
cmake_minimum_required(VERSION 3.20.0)
find_package(Zephyr REQUIRED HINTS $ENV{ZEPHYR_BASE})
project(audio_encoder_tests)

test_runner_generate(src/main.c)
target_include_directories(app PRIVATE
    ${CMAKE_CURRENT_SOURCE_DIR}/../../../src/audio
    ${CMAKE_CURRENT_SOURCE_DIR}/../../../src/utils
    ${CMAKE_CURRENT_SOURCE_DIR}/../../../src/utils/macros
    ${ZEPHYR_NRFXLIB_MODULE_DIR}/lc3/include)
# Exercise the production wrapper with a fake LC3 codec on the host.
target_compile_definitions(app PRIVATE
    CONFIG_SW_CODEC_LC3=1
    CONFIG_SW_CODEC_SELECT_LOG_LEVEL=0
    CONFIG_AUDIO_ENCODE_CHANNELS_MAX=2
    CONFIG_AUDIO_DECODE_CHANNELS_MAX=2
    CONFIG_AUDIO_OUTPUT_CHANNELS=2
    CONFIG_AUDIO_SAMPLE_RATE_HZ=48000
    CONFIG_AUDIO_BIT_DEPTH_BITS=16
    CONFIG_AUDIO_BIT_DEPTH_OCTETS=2
    CONFIG_AUDIO_FRAME_DURATION_US=10000
    CONFIG_LC3_BITRATE_MAX=96000)
target_sources(app PRIVATE src/main.c src/codec_stub.c
    ${CMAKE_CURRENT_SOURCE_DIR}/../../../src/audio/sw_codec_select.c)
```

## prj.conf
```kconfig
CONFIG_UNITY=y
CONFIG_NET_BUF=y
CONFIG_BT=y
CONFIG_PSCM=y
CONFIG_MAIN_STACK_SIZE=8192
```

## src/main.c
```c
#include <unity.h>
#include <string.h>
#include "sw_codec_select.h"

#define LEFT BT_AUDIO_LOCATION_FRONT_LEFT
#define RIGHT BT_AUDIO_LOCATION_FRONT_RIGHT
#define MONO BT_AUDIO_LOCATION_MONO_AUDIO

NET_BUF_POOL_FIXED_DEFINE(frames, 2, 32, sizeof(struct audio_metadata), NULL);
static struct net_buf *input;
static struct net_buf *output;
static const struct sw_codec_config config = {
    .sw_codec = SW_CODEC_LC3,
    .encoder = {.enabled = true, .num_ch = 2, .sample_rate_hz = 48000, .bitrate = 96000},
};
extern unsigned int encode_calls;

void setUp(void)
{
    TEST_ASSERT_EQUAL_INT(0, sw_codec_init(config));
    encode_calls = 0;
    input = net_buf_alloc(&frames, K_NO_WAIT);
    output = net_buf_alloc(&frames, K_NO_WAIT);
    TEST_ASSERT_NOT_NULL(input);
    TEST_ASSERT_NOT_NULL(output);
    memset(output->data, 0xa5, output->size);
}

void tearDown(void)
{
    net_buf_unref(input);
    net_buf_unref(output);
    TEST_ASSERT_EQUAL_INT(0, sw_codec_uninit(config));
}

static void prepare(uint32_t in_locations, uint32_t out_locations, bool interleaved)
{
    struct audio_metadata *in = net_buf_user_data(input);
    struct audio_metadata *out = net_buf_user_data(output);
    *in = (struct audio_metadata){
        .data_coding = PCM, .sample_rate_hz = 48000, .carried_bits_per_sample = 16,
        .bits_per_sample = 16, .bytes_per_location = 4, .locations = in_locations,
        .interleaved = interleaved,
    };
    *out = *in;
    out->data_coding = LC3;
    out->bytes_per_location = 2;
    out->locations = out_locations;
    const uint16_t planar[] = {0x1111, 0x1112, 0x2221, 0x2222};
    const uint16_t stereo[] = {0x1111, 0x2221, 0x1112, 0x2222};
    net_buf_add_mem(input, interleaved ? stereo : planar,
                    4 * audio_metadata_num_loc_get(in));
}

void test_disjoint_channels_reject_without_mutating_output(void)
{
    prepare(LEFT, RIGHT, false);
    struct audio_metadata before = *(struct audio_metadata *)net_buf_user_data(output);
    TEST_ASSERT_EQUAL_INT(-EINVAL, sw_codec_encode(input, output));
    TEST_ASSERT_EQUAL_UINT(0, encode_calls);
    TEST_ASSERT_EQUAL_UINT(0, output->len);
    TEST_ASSERT_EQUAL_MEMORY(&before, net_buf_user_data(output), sizeof(before));
    for (unsigned int i = 0; i < output->size; ++i) {
        TEST_ASSERT_EQUAL_HEX8(0xa5, output->data[i]);
    }
}

void test_matching_right_channel_encodes_one_frame(void)
{
    prepare(RIGHT, RIGHT, false);
    TEST_ASSERT_EQUAL_INT(0, sw_codec_encode(input, output));
    TEST_ASSERT_EQUAL_UINT(1, encode_calls);
    TEST_ASSERT_EQUAL_UINT(2, output->len);
    TEST_ASSERT_EQUAL_UINT32(RIGHT,
        ((struct audio_metadata *)net_buf_user_data(output))->locations);
}

void test_stereo_encodes_both_channels(void)
{
    prepare(LEFT | RIGHT, LEFT | RIGHT, true);
    const uint16_t expected[] = {0x1111, 0x2221};
    TEST_ASSERT_EQUAL_INT(0, sw_codec_encode(input, output));
    TEST_ASSERT_EQUAL_UINT(2, encode_calls);
    TEST_ASSERT_EQUAL_UINT(sizeof(expected), output->len);
    TEST_ASSERT_EQUAL_MEMORY(expected, output->data, sizeof(expected));
}

static void check_right_selection(bool interleaved)
{
    prepare(LEFT | RIGHT, RIGHT, interleaved);
    const uint16_t expected = 0x2221;
    TEST_ASSERT_EQUAL_INT(0, sw_codec_encode(input, output));
    TEST_ASSERT_EQUAL_UINT(1, encode_calls);
    TEST_ASSERT_EQUAL_UINT(sizeof(expected), output->len);
    TEST_ASSERT_EQUAL_MEMORY(&expected, output->data, sizeof(expected));
}

void test_select_right_from_interleaved_stereo(void) { check_right_selection(true); }
void test_select_right_from_planar_stereo(void) { check_right_selection(false); }

void test_mono_input_to_mono_output_is_valid(void)
{
    prepare(MONO, MONO, false);
    TEST_ASSERT_EQUAL_INT(0, sw_codec_encode(input, output));
    TEST_ASSERT_EQUAL_UINT(1, encode_calls);
    TEST_ASSERT_EQUAL_UINT(2, output->len);
    TEST_ASSERT_EQUAL_UINT32(MONO,
        ((struct audio_metadata *)net_buf_user_data(output))->locations);
}

void test_stereo_to_mono_selects_first_channel(void)
{
    prepare(LEFT | RIGHT, MONO, true);
    const uint16_t expected = 0x1111;
    TEST_ASSERT_EQUAL_INT(0, sw_codec_encode(input, output));
    TEST_ASSERT_EQUAL_UINT(1, encode_calls);
    TEST_ASSERT_EQUAL_UINT(sizeof(expected), output->len);
    TEST_ASSERT_EQUAL_MEMORY(&expected, output->data, sizeof(expected));
}

extern int unity_main(void);
int main(void) { return unity_main(); }
```

## src/codec_stub.c
```c
#include <stdbool.h>
#include <string.h>
#include <sw_codec_lc3.h>

/* Keep channel selection observable without the hardware LC3 library. */
unsigned int encode_calls;

int sw_codec_lc3_enc_run(void const *const pcm_data, uint32_t pcm_data_size,
                       uint32_t enc_bitrate, uint8_t audio_ch, uint16_t lc3_data_buf_size,
                       uint8_t *const lc3_data, uint16_t *const lc3_data_wr_size)
{
    ++encode_calls;
    memcpy(lc3_data, pcm_data, sizeof(uint16_t));
    *lc3_data_wr_size = sizeof(uint16_t);
    return 0;
}

int sw_codec_lc3_single_rate_init(uint16_t encoder_sample_rate, uint16_t decoder_sample_rate,
                                uint8_t *buffer, uint32_t *buffer_size, uint16_t framesize_us)
{
    return 0;
}

int sw_codec_lc3_enc_init(uint16_t pcm_sample_rate, uint8_t pcm_bit_depth, uint16_t framesize_us,
                        uint32_t enc_bitrate, uint8_t num_channels, uint16_t *const pcm_bytes_req)
{
    *pcm_bytes_req = 4;
    return 0;
}

int sw_codec_lc3_dec_init(uint16_t pcm_sample_rate, uint8_t pcm_bit_depth, uint16_t framesize_us,
                        uint8_t num_channels)
{
    return 0;
}

int sw_codec_lc3_enc_uninit_all(void) { return 0; }
int sw_codec_lc3_dec_uninit_all(void) { return 0; }
int sw_codec_lc3_uninit(void) { return 0; }
```
