#include "../../../boards/openearable_v2_nrf5340_cpuapp_fota.overlay"

/ {
	chosen {
		/* Board overlays take precedence over app_fota.overlay. */
		zephyr,code-partition = &boot_partition;
		nordic,pm-ext-flash = &mx25r64;
	};
};
