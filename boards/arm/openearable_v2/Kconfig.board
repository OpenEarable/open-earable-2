## boards/arm/openearable_v2/Kconfig.board
```kconfig
# Raytac MDBT53-DB-40 NRF5340 board configuration

# Copyright (c) 2019-2020 Nordic Semiconductor ASA
# SPDX-License-Identifier: Apache-2.0

if SOC_NRF5340_CPUAPP_QKAA

config BOARD_OPENEARABLE_V2_NRF5340_CPUAPP
	bool "OpenEarable v2 Application MCU"

config BOARD_OPENEARABLE_V2_NRF5340_CPUAPP_NS
	bool "OpenEarable v2 Application nRF5340 MCU non-secure"

endif # SOC_NRF5340_CPUAPP_QKAA

config BOARD_OPENEARABLE_V2_NRF5340_CPUNET
	bool "OpenEarable v2 nRF5340 Network MCU"
	depends on SOC_NRF5340_CPUNET_QKAA
```

## boards/teco/openearable_v2/Kconfig
```kconfig
# nRF5340 Audio DK board configuration

# Copyright (c) 2019 Nordic Semiconductor ASA
# SPDX-License-Identifier: Apache-2.0

if BOARD_OPENEARABLE_V2_NRF5340_CPUAPP || BOARD_OPENEARABLE_V2_NRF5340_CPUAPP_NS

config DOMAIN_CPUNET_BOARD
	string
	default "openearable_v2/nrf5340/cpunet"
	help
	  The board which will be used for CPUNET domain when creating a multi
	  image application where one or more images should be located on
	  another board. For example hci_ipc on the nRF5340_cpunet for
	  Bluetooth applications.

endif # BOARD_OPENEARABLE_V2_NRF5340_CPUAPP || BOARD_OPENEARABLE_V2_NRF5340_CPUAPP_NS

if BOARD_OPENEARABLE_V2_NRF5340_CPUNET

config DOMAIN_CPUAPP_BOARD
	string
	default "openearable_v2/nrf5340/cpuapp"
	help
	  The board which will be used for CPUAPP domain when creating a multi
	  image application where one or more images should be located on
	  another board.

endif # BOARD_OPENEARABLE_V2_NRF5340_CPUNET
```

## boards/teco/openearable_v2/openearable_v2_nrf5340_cpuapp_defconfig
```kconfig
# SPDX-License-Identifier: Apache-2.0

# CONFIG_SOC_SERIES_NRF53X=y
# CONFIG_SOC_NRF5340_CPUAPP_QKAA=y
# CONFIG_BOARD_OPENEARABLE_V2_NRF5340_CPUAPP=y

# Oscillator Parameters
CONFIG_CLOCK_CONTROL_NRF_K32SRC_XTAL=y
CONFIG_CLOCK_CONTROL_NRF_K32SRC_20PPM=y # as per datasheet of Seiko Epson Q13FC13500002

# Enable MPU
CONFIG_ARM_MPU=y

# Enable hardware stack protection
CONFIG_HW_STACK_PROTECTION=y

# Enable TrustZone-M
CONFIG_ARM_TRUSTZONE_M=y

# enable GPIO
CONFIG_GPIO=y

# Enable uart driver
CONFIG_SERIAL=y

# enable console
CONFIG_CONSOLE=y
CONFIG_UART_CONSOLE=y

CONFIG_REGULATOR=y
```

## boards/teco/openearable_v2/openearable_v2_nrf5340_cpuapp_ns_defconfig
```kconfig
# SPDX-License-Identifier: Apache-2.0

# CONFIG_SOC_SERIES_NRF53X=y
# CONFIG_SOC_NRF5340_CPUAPP_QKAA=y
# CONFIG_BOARD_OPENEARABLE_V2_NRF5340_CPUAPP_NS=y

# Oscillator Parameters
CONFIG_CLOCK_CONTROL_NRF_K32SRC_XTAL=y
CONFIG_CLOCK_CONTROL_NRF_K32SRC_20PPM=y # as per datasheet of Seiko Epson Q13FC13500002

# Enable MPU
CONFIG_ARM_MPU=y

# Enable hardware stack protection
CONFIG_HW_STACK_PROTECTION=y

# Enable TrustZone-M
CONFIG_ARM_TRUSTZONE_M=y

# This Board implies building Non-Secure firmware
CONFIG_TRUSTED_EXECUTION_NONSECURE=y

# Enable GPIO
CONFIG_GPIO=y

# Enable UART driver
CONFIG_SERIAL=y

# Enable console
CONFIG_CONSOLE=y
CONFIG_UART_CONSOLE=y

CONFIG_REGULATOR=y
```

## boards/teco/openearable_v2/openearable_v2_nrf5340_cpunet_defconfig
```kconfig
# SPDX-License-Identifier: Apache-2.0

# CONFIG_SOC_SERIES_NRF53X=y
# CONFIG_SOC_NRF5340_CPUNET_QKAA=y
# CONFIG_BOARD_OPENEARABLE_V2_NRF5340_CPUNET=y

# Oscillator Parameters
CONFIG_SOC_HFXO_CAP_INTERNAL=y
CONFIG_SOC_HFXO_CAP_INT_VALUE_X2=16

CONFIG_CLOCK_CONTROL_NRF_K32SRC_XTAL=y
CONFIG_CLOCK_CONTROL_NRF_K32SRC_20PPM=y # as per datasheet of Seiko Epson Q13FC13500002

CONFIG_SOC_ENABLE_LFXO=y
CONFIG_SOC_LFXO_CAP_EXTERNAL=y

# Enable MPU
CONFIG_ARM_MPU=y

# Enable hardware stack protection
CONFIG_HW_STACK_PROTECTION=y

# enable GPIO
CONFIG_GPIO=y

# Enable uart driver
CONFIG_SERIAL=y

# enable console
CONFIG_CONSOLE=y
CONFIG_UART_CONSOLE=y
```

## build/Kconfig/Kconfig.modules
```kconfig
menu "nrf (C:/ncs/v2.5.0/nrf)"
osource "C:/ncs/v2.5.0/nrf/Kconfig.nrf"
config ZEPHYR_NRF_MODULE
	bool
	default y
endmenu
menu "wfa-qt-control-app (C:/ncs/v2.5.0/modules/lib/wfa-qt-control-app)"
osource "C:/ncs/v2.5.0/modules/lib/wfa-qt-control-app/zephyr/Kconfig"
config ZEPHYR_WFA_QT_CONTROL_APP_MODULE
	bool
	default y
endmenu
menu "mcuboot (C:/ncs/v2.5.0/bootloader/mcuboot)"
osource "$(ZEPHYR_MCUBOOT_KCONFIG)"
config ZEPHYR_MCUBOOT_MODULE
	bool
	default y
endmenu
menu "mbedtls (C:/ncs/v2.5.0/modules/crypto/mbedtls)"
osource "$(ZEPHYR_MBEDTLS_KCONFIG)"
config ZEPHYR_MBEDTLS_MODULE
	bool
	default y
endmenu
menu "trusted-firmware-m (C:/ncs/v2.5.0/modules/tee/tf-m/trusted-firmware-m)"
osource "$(ZEPHYR_TRUSTED_FIRMWARE_M_KCONFIG)"
config ZEPHYR_TRUSTED_FIRMWARE_M_MODULE
	bool
	default y
endmenu
menu "cjson (C:/ncs/v2.5.0/modules/lib/cjson)"
osource "$(ZEPHYR_CJSON_KCONFIG)"
config ZEPHYR_CJSON_MODULE
	bool
	default y
endmenu
menu "azure-sdk-for-c (C:/ncs/v2.5.0/modules/lib/azure-sdk-for-c)"
osource "$(ZEPHYR_AZURE_SDK_FOR_C_KCONFIG)"
config ZEPHYR_AZURE_SDK_FOR_C_MODULE
	bool
	default y
endmenu
menu "cirrus-logic (C:/ncs/v2.5.0/modules/hal/cirrus-logic)"
osource "C:/ncs/v2.5.0/modules/hal/cirrus-logic/Kconfig"
config ZEPHYR_CIRRUS_LOGIC_MODULE
	bool
	default y
endmenu
menu "openthread (C:/ncs/v2.5.0/modules/lib/openthread)"
osource "$(ZEPHYR_OPENTHREAD_KCONFIG)"
config ZEPHYR_OPENTHREAD_MODULE
	bool
	default y
endmenu
menu "memfault-firmware-sdk (C:/ncs/v2.5.0/modules/lib/memfault-firmware-sdk)"
osource "C:/ncs/v2.5.0/modules/lib/memfault-firmware-sdk/ports/zephyr/Kconfig"
config ZEPHYR_MEMFAULT_FIRMWARE_SDK_MODULE
	bool
	default y
endmenu
menu "canopennode (C:/ncs/v2.5.0/modules/lib/canopennode)"
osource "$(ZEPHYR_CANOPENNODE_KCONFIG)"
config ZEPHYR_CANOPENNODE_MODULE
	bool
	default y
endmenu
menu "chre (C:/ncs/v2.5.0/modules/lib/chre)"
osource "C:/ncs/v2.5.0/modules/lib/chre/platform/zephyr/Kconfig"
config ZEPHYR_CHRE_MODULE
	bool
	default y
endmenu
menu "cmsis (C:/ncs/v2.5.0/modules/hal/cmsis)"
osource "$(ZEPHYR_CMSIS_KCONFIG)"
config ZEPHYR_CMSIS_MODULE
	bool
	default y
endmenu
menu "fatfs (C:/ncs/v2.5.0/modules/fs/fatfs)"
osource "$(ZEPHYR_FATFS_KCONFIG)"
config ZEPHYR_FATFS_MODULE
	bool
	default y
endmenu
menu "hal_nordic (C:/ncs/v2.5.0/modules/hal/nordic)"
osource "$(ZEPHYR_HAL_NORDIC_KCONFIG)"
config ZEPHYR_HAL_NORDIC_MODULE
	bool
	default y
endmenu
menu "liblc3 (C:/ncs/v2.5.0/modules/lib/liblc3)"
osource "$(ZEPHYR_LIBLC3_KCONFIG)"
config ZEPHYR_LIBLC3_MODULE
	bool
	default y
endmenu
menu "littlefs (C:/ncs/v2.5.0/modules/fs/littlefs)"
osource "$(ZEPHYR_LITTLEFS_KCONFIG)"
config ZEPHYR_LITTLEFS_MODULE
	bool
	default y
endmenu
menu "loramac-node (C:/ncs/v2.5.0/modules/lib/loramac-node)"
osource "$(ZEPHYR_LORAMAC_NODE_KCONFIG)"
config ZEPHYR_LORAMAC_NODE_MODULE
	bool
	default y
endmenu
menu "lvgl (C:/ncs/v2.5.0/modules/lib/gui/lvgl)"
osource "C:/ncs/v2.5.0/modules/lib/gui/lvgl/Kconfig"
config ZEPHYR_LVGL_MODULE
	bool
	default y
endmenu
menu "lz4 (C:/ncs/v2.5.0/modules/lib/lz4)"
osource "$(ZEPHYR_LZ4_KCONFIG)"
config ZEPHYR_LZ4_MODULE
	bool
	default y
endmenu
menu "nanopb (C:/ncs/v2.5.0/modules/lib/nanopb)"
osource "$(ZEPHYR_NANOPB_KCONFIG)"
config ZEPHYR_NANOPB_MODULE
	bool
	default y
endmenu
menu "picolibc (C:/ncs/v2.5.0/modules/lib/picolibc)"
osource "C:/ncs/v2.5.0/modules/lib/picolibc/zephyr/Kconfig"
config ZEPHYR_PICOLIBC_MODULE
	bool
	default y
endmenu
menu "segger (C:/ncs/v2.5.0/modules/debug/segger)"
osource "$(ZEPHYR_SEGGER_KCONFIG)"
config ZEPHYR_SEGGER_MODULE
	bool
	default y
endmenu
menu "TraceRecorder (C:/ncs/v2.5.0/modules/debug/TraceRecorder)"
osource "C:/ncs/v2.5.0/modules/debug/TraceRecorder/kernelports/Zephyr/Kconfig"
config ZEPHYR_TRACERECORDER_MODULE
	bool
	default y
endmenu
menu "uoscore-uedhoc (C:/ncs/v2.5.0/modules/lib/uoscore-uedhoc)"
osource "$(ZEPHYR_UOSCORE_UEDHOC_KCONFIG)"
config ZEPHYR_UOSCORE_UEDHOC_MODULE
	bool
	default y
endmenu
menu "zcbor (C:/ncs/v2.5.0/modules/lib/zcbor)"
osource "$(ZEPHYR_ZCBOR_KCONFIG)"
config ZEPHYR_ZCBOR_MODULE
	bool
	default y
endmenu
menu "zscilib (C:/ncs/v2.5.0/modules/lib/zscilib)"
osource "C:/ncs/v2.5.0/modules/lib/zscilib/Kconfig.zscilib"
config ZEPHYR_ZSCILIB_MODULE
	bool
	default y
endmenu
menu "nrfxlib (C:/ncs/v2.5.0/nrfxlib)"
osource "C:/ncs/v2.5.0/nrfxlib/Kconfig.nrfxlib"
config ZEPHYR_NRFXLIB_MODULE
	bool
	default y
endmenu
menu "connectedhomeip (C:/ncs/v2.5.0/modules/lib/matter)"
osource "C:/ncs/v2.5.0/modules/lib/matter/config/nrfconnect/chip-module/Kconfig"
config ZEPHYR_CONNECTEDHOMEIP_MODULE
	bool
	default y
endmenu
```

## build/Kconfig/Kconfig.sysbuild.modules
```kconfig
menu "nrf (C:/ncs/v2.5.0/nrf)"
osource "C:/ncs/v2.5.0/nrf/sysbuild/Kconfig.sysbuild"
config ZEPHYR_NRF_MODULE
	bool
	default y
endmenu
```

## dts/bindings/ti,bq27220.yaml
```yaml
#
# Copyright 2021 Grinn
#
# SPDX-License-Identifier: Apache-2.0
#

include: [sensor-device.yaml, i2c-device.yaml]

compatible: "ti,bq27220"

properties:
  gpout-gpios:
    type: phandle-array
    description: Alert pin
```

## src/Battery/Kconfig
```kconfig
menu "Battery Configuration"

config AUTO_OFF_MAX_PARTICIPANTS
	int "Maximum number of participants in auto-off"
	range 1 32
	default 8
	help
	  Maximum number of participants that can register with AutoOffManager.

config AUTO_OFF_DEFAULT_POWER_SAVING_MODE
	int "Default auto-off power saving mode"
	range 0 3
	default 2
	help
	  Default mode for automatic power-off.
	  Values: 0=off, 1=minimal, 2=balanced, 3=aggressive.

config POWER_SAVING_LEVEL_LEAUDIO
	int "LE Audio auto-off power saving level"
	range 0 3
	default 3
	help
	  First power saving mode where LE Audio participates in auto-off.
	  Values: 0=off, 1=minimal, 2=balanced, 3=aggressive.

config POWER_SAVING_LEVEL_SENSOR_MANAGER
	int "SensorManager auto-off power saving level"
	range 0 3
	default 2
	help
	  First power saving mode where SensorManager participates in auto-off.
	  Values: 0=off, 1=minimal, 2=balanced, 3=aggressive.

config AUTO_OFF_TIMEOUT_AGGRESSIVE
	int "Aggressive auto-off timeout in minutes"
	range 1 1440
	default 5
	help
	  Idle time before power-off when auto-off is in aggressive mode.

config AUTO_OFF_TIMEOUT_BALANCED
	int "Balanced auto-off timeout in minutes"
	range 1 1440
	default 15
	help
	  Idle time before power-off when auto-off is in balanced mode.

config AUTO_OFF_TIMEOUT_MINIMAL
	int "Minimal auto-off timeout in minutes"
	range 1 1440
	default 30
	help
	  Idle time before power-off when auto-off is in minimal mode.

config BATTERY_SYSDOWN_SET_OFFSET
	int "System Down Set Voltage Offset (mV)"
	default 250
	help
	  Offset added to VLO voltage for System Down Set threshold

config BATTERY_SYSDOWN_HYSTERESIS
	int "System Down Clear Voltage Offset (mV)"
	default 100
	help
	  Offset added to VLO voltage for System Down Clear threshold

config BATTERY_FD_SET_OFFSET
	int "Full Discharge Set Voltage Offset (mV)"
	default 100
	help
	  Offset added to VLO voltage for Full Discharge Set threshold

config BATTERY_FD_HYSTERESIS
	int "Full Discharge Clear Voltage Offset (mV)"
	default 100
	help
	  Offset added to VLO voltage for Full Discharge Clear threshold

config BATTERY_FC_VOLTAGE_OFFSET
	int "Full Charge Voltage Offset (mV)"
	default 10
	help
	  Offset subtracted from terminal voltage for Full Charge threshold

config BATTERY_CHARGE_CONTROLLER_INTERVAL_SECONDS
	int "Charge Controller Check Interval (seconds)"
	default 10
	help
	  Time interval between charge controller status checks

config BATTERY_CHARGE_CONTROLLER_NORMAL_INTERVAL_SECONDS
	int "Normal Charge Controller Check Interval (seconds)"
	default 10
	help
	  Time interval between charge controller status checks in normal operation

config BATTERY_CHARGE_CONTROLLER_FAST_INTERVAL_SECONDS
	int "Fast Charge Controller Check Interval (seconds)"
	default 1
	help
	  Time interval between charge controller status checks when in FAULT or POWER_CONNECTED state

config BATTERY_ENABLE_LOW_STATE
	bool "Enable Battery Low State"
	default n
	help
	  If enabled, battery state will change to BATTERY_LOW when EDV2 is reached

config BATTERY_ENABLE_TRICKLE_CHARGE
	bool "Enable Trickle Charge State"
	default y
	help
	  If enabled, battery state will change to TRICKLE_CHARGING when voltage is close to terminal voltage

config SETUP_FUEL_GAUGE
	bool "Setup Fuel Gauge on Boot"
	default n
	help
	  If enabled, fuel gauge will be setup during boot process

endmenu
```

## unicast_server/Kconfig.defaults
```kconfig
#
# Copyright (c) 2025 Nordic Semiconductor ASA
#
# SPDX-License-Identifier: LicenseRef-Nordic-5-Clause
#

config AUDIO_DEV
	default 1

config BT_GATT_AUTO_DISCOVER_CCC
	default y

config BT_GATT_AUTO_RESUBSCRIBE
	default n

config BT_GATT_AUTO_SEC_REQ
	default n

config BT_GATT_AUTO_UPDATE_MTU
	default y

config BT_GATT_CACHING
	default n

config BT_GATT_CLIENT
	default y

config BT_GATT_DYNAMIC_DB
	default y

config BT_MAX_CONN
	default 4

config BT_MAX_PAIRED
	default 4

config BT_EXT_ADV
	default y

config BT_AUDIO
	default y

config BT_PERIPHERAL
	default y

config BT_ISO_PERIPHERAL
	default y

config BT_BAP_UNICAST_SERVER
	default y

config BT_CAP_ACCEPTOR
	default y

config BT_CAP_ACCEPTOR_SET_MEMBER
	default y

config BT_PAC_SNK
	default y

config BT_PAC_SNK_NOTIFIABLE
	default y

config BT_PAC_SRC
	default y

config BT_PAC_SRC_NOTIFIABLE
	default y

config BT_CSIP_SET_MEMBER
	default y

config BT_DEVICE_APPEARANCE
	default 2369

config BT_ISO_MAX_CHAN
	default 2

config BT_ASCS
	default y

config BT_ASCS_MAX_ASE_SNK_COUNT
	default 1

config BT_ASCS_MAX_ASE_SRC_COUNT
	default 1

config BT_VCP_VOL_REND
	default y

config BT_MCC
	default y

config BT_MCC_READ_MEDIA_STATE
	default y

config BT_MCC_SET_MEDIA_CONTROL_POINT
	default y

config BT_GAP_PERIPHERAL_PREF_PARAMS
	default n

config BT_AUDIO_CODEC_CFG_MAX_METADATA_SIZE
	default 25

config LC3_ENC_CHAN_MAX
	default 1

config LC3_DEC_CHAN_MAX
	default 1

config MBEDTLS_ENABLE_HEAP
	default y

config MBEDTLS_HEAP_SIZE
	default 2048
```

## west.yml
```yaml
manifest:
  version: "0.10"
  projects:
    # Specify the nRF-Connect SDK as a project dependency.
    - name: sdk-nrf
      path: nrf
      url: https://github.com/nrfconnect/sdk-nrf.git
      revision: v3.0.1
      import: true

    - name: openearable-protocol
      url: https://github.com/OpenEarable/protocol.git
      revision: main
      path: external/protocol
      # import: true
```
