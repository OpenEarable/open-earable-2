## boards/teco/openearable_v2/board.yml
```yaml
board:
  name: openearable_v2
  full_name: OpenEarable V2
  vendor: teco
  socs:
  - name: 'nrf5340'
    variants:
    - name: 'ns'
      cpucluster: 'cpuapp'
```

## src/SensorManager/Kconfig
```kconfig
menu "SensorManager"

#----------------------------------------------------------------------------#
menu "Thread priorities"

config SENSOR_PUB_THREAD_PRIO
	int "Priority for power measurement thread"
	default 5
	help
	  This thread will publish sensor events to zbus.

config SENSOR_WORK_QUEUE_PRIO
	int "Priority for power measurement thread"
	default 5
	help
	  This thread will publish sensor events to zbus.

config SENSOR_CONFIG_WORK_QUEUE_PRIO
	int "Priority for the sensor configuration work queue"
	default 10
	help
	  Preemptible, and below the Bluetooth controller poll thread, because
	  applying a configuration can block on the SD card for a while.

config SENSOR_GATT_NOTIFY_THREAD_PRIO
	int "Priority for volume message subscribe thread"
	default 6
	help
	  This is a preemptible thread.
	  This thread will subscribe to sensor events from zbus.

config SENSOR_SD_THREAD_PRIO
    int "Priority for volume message subscribe thread"
	default 5
	help
	  This is a preemptible thread.
	  This thread will subscribe to sensor events from zbus.
endmenu # Thread priorities

#----------------------------------------------------------------------------#
menu "Stack sizes"

config SENSOR_PUB_STACK_SIZE
	int "Stack size for power measurement thread"
	default 2048

config SENSOR_WORK_QUEUE_STACK_SIZE
	int "Stack size for power measurement thread"
	default 1024

config SENSOR_CONFIG_WORK_QUEUE_STACK_SIZE
	int "Stack size for the sensor configuration work queue"
	default 4096
	help
	  Applying a sensor configuration mounts the SD card and writes the log
	  file header, so this queue needs room for the filesystem stack.

config SENSOR_GATT_NOTIFY_STACK_SIZE
	int "Stack size"
	default 2048

config SENSOR_SD_STACK_SIZE
    int "Stack size"
	default 8192

endmenu # Stack sizes

#----------------------------------------------------------------------------#
menu "Zbus"

config SENSOR_SD_SUB_QUEUE_SIZE
	int "Queue size for button subscriber"
	default 256

config SENSOR_GATT_SUB_QUEUE_SIZE
	int "Queue size for content control subscriber"
	default 256

endmenu # Zbus

#-----------------------------------------------------------------------------#
menu "Buffer management"

config SENSOR_CLOCK_ACCURACY
	int "Clock accuracy"
	default 5
	help
	  This is the clock accuracy in percent. The default value is 5 percent.
	  This value is used to calculate the time difference between the
	  sensor and the system clock. The value is used to calculate the
	  time difference between the sensor and the system clock.

config SENSOR_LATENCY_MS
	int "Latency"
	default 40
	help
	  This is the latency in milliseconds. The default value is 40 ms.
	  This value is used to calaculate the buffer size of the sensors
	  that use an internal buffer.

endmenu # Buffer management

endmenu # Modules
```

## src/bluetooth/bt_management/Kconfig
```kconfig
#
# Copyright (c) 2023 Nordic Semiconductor ASA
#
# SPDX-License-Identifier: LicenseRef-Nordic-5-Clause
#

menu "BT management"

rsource "controller_config/Kconfig"

config WDT_CTLR
	bool "Enable watchdog for controller"
	default y
	select WATCHDOG
	select TASK_WDT
	help
	  Poll the controller every two seconds to detect an IPC or controller stall.
	  The watchdog is stopped before shutdown or entering standalone DFU mode.

config CTLR_POLL_WORK_Q_PRIO
	int "Work queue priority for controller poll"
	default 2
	depends on WDT_CTLR

#----------------------------------------------------------------------------#
rsource "dfu/Kconfig"
rsource "advertising/Kconfig"
rsource "scanning/Kconfig"

#----------------------------------------------------------------------------#
menu "Log level"

module = BT_MGMT
module-str = bt-mgmt
source "subsys/logging/Kconfig.template.log_config"

endmenu # Log level
endmenu # BT management
```

## src/drivers/Kconfig
```kconfig
#
# Copyright (c) 2022 Nordic Semiconductor ASA
#
# SPDX-License-Identifier: LicenseRef-Nordic-5-Clause
#

menu "Drivers"

menuconfig NRF5340_AUDIO_CS47L63_DRIVER
	bool "CS47L63 HW codec driver"
	depends on BOARD_NRF5340_AUDIO_DK_NRF5340_CPUAPP
	select HW_CODEC_CIRRUS_LOGIC
	help
	  Include the driver for the Cirrus Logic CS47L63 hardware codec chip

if NRF5340_AUDIO_CS47L63_DRIVER

config CS47L63_THREAD_PRIO
	int "Priority for CS47L63 thread"
	default 5
	help
	  This is a preemptible thread

config CS47L63_STACK_SIZE
	int "Stack size for CS47L63"
	default 700

module = CS47L63
module-str = cs47l63
source "subsys/logging/Kconfig.template.log_config"

endif # NRF5340_AUDIO_CS47L63_DRIVER

menuconfig NRF5340_AUDIO_ADAU1860_DRIVER
	bool "ADAU1860 HW codec driver"
	depends on BOARD_OPENEARABLE_V2_NRF5340_CPUAPP || BOARD_OPENEARABLE_V2_NRF5340_CPUAPP_NS
	default y if BOARD_OPENEARABLE_V2_NRF5340_CPUAPP || BOARD_OPENEARABLE_V2_NRF5340_CPUAPP_NS
	help
	  Include the driver for the Analog Devices ADAU1860 hardware codec chip

if NRF5340_AUDIO_ADAU1860_DRIVER

config ADAU1860_THREAD_PRIO
	int "Priority for ADAU1860 thread"
	default 5
	help
	  This is a preemptible thread

config ADAU1860_STACK_SIZE
	int "Stack size for ADAU1860"
	default 700

choice EQUALIZER
	prompt "Choose EQ on DSP or MCU ISO transport"
	default EQAULIZER_DSP

config EQAULIZER_DSP
	bool "Use DSP for EQ"
	
config EQUALIZER_SOFTWARE
	bool "Use software EQ on MCU"

endchoice

config FDSP
	depends on EQAULIZER_DSP
	default y
	bool "Use FDSP the fast DSP core. This is required for Transparancy mode and ANC."

module = ADAU1860
module-str = adau1860
source "subsys/logging/Kconfig.template.log_config"

endif # NRF5340_AUDIO_ADAU1860_DRIVER
endmenu # Drivers
```

## tests/unit/audio_sdu_timing/testcase.yaml
```yaml
tests:
  openearable.unit.audio_sdu_timing:
    tags:
      - unit
      - audio
    integration_platforms:
      - native_sim/native/64
    platform_allow:
      - native_sim/native/64
```

## tests/unit/audio_startup/testcase.yaml
```yaml
tests:
  openearable.unit.audio_startup:
    tags:
      - unit
      - audio
    integration_platforms:
      - native_sim/native/64
    platform_allow:
      - native_sim/native/64
```

## tests/unit/battery_profile/testcase.yaml
```yaml
tests:
  openearable.unit.battery_profile:
    tags:
      - unit
      - battery
    integration_platforms:
      - native_sim/native/64
    platform_allow:
      - native_sim/native/64
```

## tests/unit/bond_cleanup/testcase.yaml
```yaml
tests:
  openearable.unit.bond_cleanup:
    tags:
      - unit
      - bluetooth
    integration_platforms:
      - native_sim/native/64
    platform_allow:
      - native_sim/native/64
```

## tests/unit/csip_identity/testcase.yaml
```yaml
tests:
  openearable.unit.csip_identity:
    tags:
      - unit
      - bluetooth
    integration_platforms:
      - native_sim/native/64
    platform_allow:
      - native_sim/native/64
```

## tests/unit/fifo_timestamps/testcase.yaml
```yaml
tests:
  openearable.unit.fifo_timestamps:
    tags: [unit, sensor]
    integration_platforms: [native_sim/native/64]
    platform_allow: [native_sim/native/64]
```

## tests/unit/ring_buffer/testcase.yaml
```yaml
tests:
  openearable.unit.ring_buffer:
    tags:
      - unit
      - wire
    integration_platforms:
      - native_sim/native/64
    platform_allow:
      - native_sim/native/64
```

## tests/unit/sensor_component/testcase.yaml
```yaml
tests:
  openearable.unit.sensor_component:
    tags:
      - unit
      - parse_info
    integration_platforms:
      - native_sim/native/64
    platform_allow:
      - native_sim/native/64
```

## tests/unit/sensor_fair_queue/testcase.yaml
```yaml
tests:
  openearable.unit.sensor_fair_queue:
    tags:
      - unit
      - bluetooth
    integration_platforms:
      - native_sim/native/64
    platform_allow:
      - native_sim/native/64
```

## tests/unit/sensor_transport/testcase.yaml
```yaml
tests:
  openearable.unit.sensor_transport:
    tags: [unit, bluetooth]
    integration_platforms: [native_sim/native/64]
    platform_allow: [native_sim/native/64]
```

## tests/unit/usb_recovery/testcase.yaml
```yaml
tests:
  openearable.unit.usb_recovery:
    tags:
      - unit
      - battery
    integration_platforms:
      - native_sim/native/64
    platform_allow:
      - native_sim/native/64
```
